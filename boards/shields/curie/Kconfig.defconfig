## boards/shields/curie/Kconfig.defconfig
```kconfig
if SHIELD_CURIE_LEFT

# Name must be less than 16 characters long!
config ZMK_KEYBOARD_NAME
    default "Curie"

config ZMK_SPLIT_ROLE_CENTRAL
    default y

endif # SHIELD_CURIE_LEFT

if SHIELD_CURIE_LEFT || SHIELD_CURIE_RIGHT

config ZMK_SPLIT
    default y

endif # SHIELD_CURIE_LEFT || SHIELD_CURIE_RIGHT


config SPI
    default y

if ZMK_DISPLAY

choice ZMK_DISPLAY_WORK_QUEUE
    default ZMK_DISPLAY_WORK_QUEUE_DEDICATED
endchoice

config LV_Z_VDB_SIZE
	default 64
    
config LV_DPI_DEF
    default 148

config LV_Z_BITS_PER_PIXEL
    default 16

choice ST7789V_PIXEL_FORMAT
    default ST7789V_RGB565
endchoice

choice LV_COLOR_DEPTH
    default LV_COLOR_DEPTH_16
endchoice

# config LV_MEM_SIZE
#     default (48U * 1024U) 

endif # ZMK_DISPLAY


# if LVGL

# config LV_Z_VDB_SIZE
# 	default 64

# config LV_Z_BITS_PER_PIXEL
# 	default 1

# choice LV_COLOR_DEPTH
# 	default LV_COLOR_DEPTH_1
# endchoice

# endif # LVGL
```

## boards/shields/curie/Kconfig.shield
```kconfig
# Copyright (c) 2024 Lynnlee
# SPDX-License-Identifier: MIT

config SHIELD_CURIE_LEFT
def_bool $(shields_list_contains,curie_left)

config SHIELD_CURIE_RIGHT
def_bool $(shields_list_contains,curie_right)
```

## config/west.yml
```yaml
---
manifest:
  remotes:
  name: zmkfirmware
      url-base: https://github.com/zmkfirmware
  projects:
    - name: zmk_offical
      url: https://github.com/lynnlee0522/zmk_offical
      revision: main
      import: app/west.yml
  self:
    path: config
```
