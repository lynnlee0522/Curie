/*
 * Copyright (c) 2020 Pete Johanson
 *
 * SPDX-License-Identifier: MIT
 */

#include "curie.dtsi"

&kscan0 {
	col-gpios
	= <&gpio1 13 GPIO_PULL_DOWN>
	, <&gpio1 15 GPIO_PULL_DOWN>
	, <&gpio0 2 GPIO_PULL_DOWN>
	, <&gpio0 29 GPIO_PULL_DOWN>
	, <&gpio0 31 GPIO_PULL_DOWN>
	;
};

// &left_encoder {
	//     status = "okay";
// };